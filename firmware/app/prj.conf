## CMakeLists.txt
```
cmake_minimum_required(VERSION 3.20.0)

set(ZEPHYR_EXTRA_MODULES "${CMAKE_CURRENT_SOURCE_DIR}/../modules/drv8434s")
set(BOARD_ROOT "${CMAKE_CURRENT_SOURCE_DIR}/..")
set(BOARD "brownstudios_bedlift")
set(BOARD_DEBUG_RUNNER openocd)
set(BOARD_FLASH_RUNNER openocd)

if(FEATURE_DEBUG)
    set(CONFIG_DEBUG y)
    set(CONFIG_DEBUG_THREAD_INFO y)
endif()

if(FEATURE_LOG)
    list(APPEND EXTRA_CONF_FILE log-deferred.conf)
    #list(APPEND EXTRA_CONF_FILE log-minimal.conf)
else()
    list(APPEND EXTRA_CONF_FILE log-none.conf)
endif()

find_package(Zephyr REQUIRED HINTS $ENV{ZEPHYR_BASE})
project(bedlift)

target_sources(app PRIVATE
    src/bed/bed.c
    src/bed/lift.c
    src/bed/span.c
    src/control.c
    src/indicator.c
    src/main.c
    src/melody.c
    src/monitor.c
    src/power.c
)

target_include_directories(app PRIVATE
    src
)
```

## prj.conf
```kconfig
# Configure device drivers
CONFIG_GPIO=y
CONFIG_PWM=y
CONFIG_DRV8434S=y
CONFIG_COUNTER=y
CONFIG_WATCHDOG=y
CONFIG_WDT_DISABLE_AT_BOOT=y

# Enable link time optimization to save flash (about 2 KB for this project)
CONFIG_LTO=y
CONFIG_ISR_TABLES_LOCAL_DECLARATION=y

# Enable I2C driver for target mode and enable interrupts
# Controller mode not used so DMA and RTIO are irrelevant
# Disabled for now to save flash space until I2C features are implemented
CONFIG_I2C=y
CONFIG_I2C_TARGET=y
CONFIG_I2C_RTIO=n
CONFIG_I2C_STM32_INTERRUPT=y
CONFIG_I2C_STM32_V2_DMA=n

# Enable SPI driver for controller mode
CONFIG_SPI=y
CONFIG_SPI_RTIO=n
# Option 1: ASYNC mode with interrupts
CONFIG_SPI_ASYNC=y
CONFIG_SPI_STM32_INTERRUPT=y
CONFIG_SPI_STM32_DMA=n
# Option 2: DMA mode (doesn't support ASYNC so it has twice the context switch overhead)
# CONFIG_SPI_ASYNC=n
# CONFIG_SPI_STM32_INTERRUPT=n
# CONFIG_SPI_STM32_DMA=y

# Disable unnecessary kernel features to reduce footprint
# CONFIG_POLL=n # Selected by CONFIG_SPI_ASYNC but we don't actually need it
CONFIG_ERRNO=n
CONFIG_DEVICE_DEINIT_SUPPORT=n
CONFIG_NUM_MBOX_ASYNC_MSGS=0

# Reducing the timeout resolution to 32 bits removes absolute timeout
# functions and saves about 360 bytes of flash.
CONFIG_TIMEOUT_64BIT=n

# Ensure code hygiene
CONFIG_LEGACY_GENERATED_INCLUDE_PATH=n

# Output disassembly and symbols to facilitate optimization during development
CONFIG_OUTPUT_DISASSEMBLY=y
CONFIG_OUTPUT_SYMBOLS=y
```

## src/main.c
```c
#include <zephyr/drivers/gpio.h>
#include <zephyr/drivers/watchdog.h>
#include <zephyr/kernel.h>
#include <zephyr/logging/log.h>

#include "bed/bed.h"
#include "bed/lift.h"
#include "bed/span.h"
#include "control.h"
#include "indicator.h"
#include "melody.h"
#include "monitor.h"
#include "power.h"

LOG_MODULE_REGISTER(app);

#define WATCHDOG_TIMEOUT_MS (1000)
static const struct device *watchdog_dev = DEVICE_DT_GET(DT_NODELABEL(iwdg));

// Timeout for the indicator to go dark after completing an activity.
#define ACTIVITY_TIMEOUT_MS (1500)

// Timeout to revert to the main menu after completing an activity.
#define MENU_TIMEOUT_MS (15000)

/*
 * Error codes.
 */

INDICATOR_PATTERN_LOOP(indicator_pattern_aborted, 0,
    INDICATOR_PATTERN_ENTRY(INDICATOR_HUE_AMBER, 2, 2, 1));

INDICATOR_PATTERN_LOOP(indicator_pattern_generic_error, 0,
    INDICATOR_PATTERN_ENTRY(INDICATOR_HUE_RED, 2, 2, 1));

INDICATOR_PATTERN_LOOP(indicator_pattern_control_error, 4,
    INDICATOR_PATTERN_ENTRY(INDICATOR_HUE_RED, 5, 3, 1),
    INDICATOR_PATTERN_ENTRY(INDICATOR_HUE_MAGENTA, 1, 3, INDICATOR_PATTERN_PARAM_CYCLES));

INDICATOR_PATTERN_LOOP(indicator_pattern_bed_error, 4,
    INDICATOR_PATTERN_ENTRY(INDICATOR_HUE_RED, 5, 3, 1),
    INDICATOR_PATTERN_ENTRY(INDICATOR_HUE_AMBER, 1, 3, INDICATOR_PATTERN_PARAM_CYCLES));

INDICATOR_PATTERN_LOOP(indicator_pattern_lift_error, 4,
    INDICATOR_PATTERN_ENTRY(INDICATOR_HUE_RED, 5, 3, 1),
    INDICATOR_PATTERN_ENTRY(INDICATOR_HUE_CYAN, 1, 3, INDICATOR_PATTERN_PARAM_CYCLES));

INDICATOR_PATTERN_LOOP(indicator_pattern_span_error, 4,
    INDICATOR_PATTERN_ENTRY(INDICATOR_HUE_RED, 5, 3, 1),
    INDICATOR_PATTERN_ENTRY(INDICATOR_HUE_BLUE, 1, 3, INDICATOR_PATTERN_PARAM_CYCLES));

static void show_error(int err) {
    switch (ERROR_CATEGORY(err)) {
        case ERROR_CATEGORY(CONTROL_ERROR_FIRST_):
            indicator_pattern(indicator_pattern_control_error, ERROR_INDEX(err));
            break;
        case ERROR_CATEGORY(BED_ERROR_FIRST_):
            indicator_pattern(indicator_pattern_bed_error, ERROR_INDEX(err));
            break;
        case ERROR_CATEGORY(LIFT_ERROR_FIRST_):
            indicator_pattern(indicator_pattern_lift_error, ERROR_INDEX(err));
            break;
        case ERROR_CATEGORY(SPAN_ERROR_FIRST_):
            indicator_pattern(indicator_pattern_span_error, ERROR_INDEX(err));
            break;
        default:
            indicator_pattern(indicator_pattern_generic_error, 0);
            break;
    }
}

/*
 * Melodies.
 */

MELODY(melody_error_forbidden,
    MELODY_NOTE(E6, 50), MELODY_REST(50), MELODY_NOTE(E6, 50), MELODY_REST(50), MELODY_NOTE(E6, 50));

MELODY(melody_error_alert,
    MELODY_NOTE(E6, 500), MELODY_REST(250), MELODY_NOTE(E6, 500), MELODY_REST(250), MELODY_NOTE(E6, 500));

MELODY(melody_pose_lounge,
    MELODY_NOTE(E6, 50), MELODY_REST(50), MELODY_NOTE(E6, 50), MELODY_REST(50), MELODY_NOTE(G6, 250));

MELODY(melody_pose_sleep,
    MELODY_NOTE(E6, 50), MELODY_REST(50), MELODY_NOTE(E6, 50), MELODY_REST(50), MELODY_NOTE(C6, 250));

MELODY(melody_menu_mode,
    MELODY_NOTE(E6, 50));

MELODY(melody_menu_main,
    MELODY_NOTE(E6, 50), MELODY_REST(25), MELODY_NOTE(F6, 25), MELODY_REST(25),
    MELODY_NOTE(E6, 25), MELODY_REST(25), MELODY_NOTE(D6, 25), MELODY_REST(25),
    MELODY_NOTE(E6, 50));

MELODY(melody_menu_jog_lift,
    MELODY_NOTE(E6, 50), MELODY_REST(50), MELODY_NOTE(F6, 50), MELODY_REST(50), MELODY_NOTE(G6, 50));

MELODY(melody_menu_jog_span,
    MELODY_NOTE(E6, 50), MELODY_REST(50), MELODY_NOTE(D6, 50), MELODY_REST(50), MELODY_NOTE(C6, 50));

static void melody_play_error(int err) {
    switch (err) {
        case CONTROL_ERROR_INHIBITED:
            melody_play(melody_error_forbidden);
            break;
        default:
            melody_play(melody_error_alert);
            break;
    }
}

static void melody_play_pose(void) {
    switch (bed_get_current_pose()) {
        case BED_POSE_LOUNGE:
            melody_play(melody_pose_lounge);
            break;
        case BED_POSE_SLEEP:
            melody_play(melody_pose_sleep);
            break;
        default:
            break;
    }
}

/*
 * Jog specifications.
 */

INDICATOR_PATTERN_LOOP(indicator_pattern_jog_lift, 4,
    INDICATOR_PATTERN_ENTRY(INDICATOR_HUE_AMBER, 5, 3, 1),
    INDICATOR_PATTERN_ENTRY(INDICATOR_HUE_CYAN, 1, 3, INDICATOR_PATTERN_PARAM_CYCLES));

struct jog_lift_spec {
    enum lift_move move;
    unsigned indicator_pattern_param;
};
static const struct jog_lift_spec jog_lift_specs[] = {
    { .move = LIFT_MOVE_TANDEM, .indicator_pattern_param = 1,  },
    { .move = LIFT_MOVE_INDEPENDENT_BOTH, .indicator_pattern_param = 2 },
    { .move = LIFT_MOVE_INDEPENDENT_1, .indicator_pattern_param = 3 },
    { .move = LIFT_MOVE_INDEPENDENT_2, .indicator_pattern_param = 4 },
};

INDICATOR_PATTERN_LOOP(indicator_pattern_jog_span, 4,
    INDICATOR_PATTERN_ENTRY(INDICATOR_HUE_AMBER, 5, 3, 1),
    INDICATOR_PATTERN_ENTRY(INDICATOR_HUE_BLUE, 1, 3, INDICATOR_PATTERN_PARAM_CYCLES));

struct jog_span_spec {
    enum span_move move;
    unsigned actuator_set;
    unsigned indicator_pattern_param;
};
static const struct jog_span_spec jog_span_specs[] = {
    { .move = SPAN_MOVE_HOME, .actuator_set = SPAN_ACTUATOR_SET_ALL, .indicator_pattern_param = 1 },
    { .move = SPAN_MOVE_HOME, .actuator_set = SPAN_ACTUATOR_SET_01, .indicator_pattern_param = 2 },
    { .move = SPAN_MOVE_HOME, .actuator_set = SPAN_ACTUATOR_SET_23, .indicator_pattern_param = 3 },
    { .move = SPAN_MOVE_JOG, .actuator_set = BIT(0), .indicator_pattern_param = 4 },
    { .move = SPAN_MOVE_JOG, .actuator_set = BIT(1), .indicator_pattern_param = 5 },
    { .move = SPAN_MOVE_JOG, .actuator_set = BIT(2), .indicator_pattern_param = 6 },
    { .move = SPAN_MOVE_JOG, .actuator_set = BIT(3), .indicator_pattern_param = 7 },
};

/*
 * Menus.
 */

enum menu {
    MENU_MAIN = 0,
    MENU_JOG_LIFT = 1,
    MENU_JOG_SPAN = 2,
};

struct menu_spec {
    const unsigned mode_count;
    const melody_t *melody;
};
static const struct menu_spec menu_specs[] = {
    { 0, melody_menu_main },
    { ARRAY_SIZE(jog_lift_specs), melody_menu_jog_lift },
    { ARRAY_SIZE(jog_span_specs), melody_menu_jog_span },
};

static enum menu menu;
static unsigned menu_mode;

/*
 * Control interface.
 */

static int do_rest(void) {
    return bed_poll_stop();
}

static void do_goto_menu(enum menu new_menu) {
    menu_mode = 0;
    if (menu != new_menu) {
        menu = new_menu;
        melody_play(menu_specs[menu].melody);
    }
}

static void do_next_menu(void) {
    do_goto_menu(menu + 1 >= ARRAY_SIZE(menu_specs) ? MENU_MAIN : menu + 1);
}

static void do_next_menu_mode(void) {
    const unsigned count = menu_specs[menu].mode_count;
    if (count) {
        menu_mode += 1;
        if (menu_mode >= count) {
            menu_mode = 0;
        }
        melody_play(melody_menu_mode);
    }
}

static int do_move(bool up, struct monitor_setting setting) {
    if (setting.control_inhibit) {
        return CONTROL_ERROR_INHIBITED;
    }
    switch (menu) {
        case MENU_MAIN:
            return bed_poll_pose(up ? BED_POSE_LOUNGE : BED_POSE_SLEEP);
        case MENU_JOG_LIFT: {
            bed_prepare_for_manual_action();
            int span_err = span_poll_sleep();
            int lift_err = lift_poll_jog(jog_lift_specs[menu_mode].move, up);
            return span_err ? span_err : lift_err;
        }
        case MENU_JOG_SPAN: {
            bed_prepare_for_manual_action();
            int span_err = span_poll_jog(jog_span_specs[menu_mode].move, up, jog_span_specs[menu_mode].actuator_set);
            int lift_err = lift_poll_sleep();
            return span_err ? span_err : lift_err;
        }
        default:
            return 0;
    }
}

static void show_status(void) {
    switch (menu) {
        case MENU_JOG_LIFT:
            indicator_pattern(indicator_pattern_jog_lift, 
                    jog_lift_specs[menu_mode].indicator_pattern_param);
            break;
        case MENU_JOG_SPAN:
            indicator_pattern(indicator_pattern_jog_span,
                    jog_span_specs[menu_mode].indicator_pattern_param);
            break;
        case MENU_MAIN:
        default:
            switch (bed_get_state()) {
                case BED_STATE_ERROR:
                    indicator_pattern(indicator_pattern_generic_error, 0);
                    break;
                case BED_STATE_ABORTED:
                    indicator_pattern(indicator_pattern_aborted, 0);
                    break;
                case BED_STATE_MOVING:
                    switch (bed_get_target_pose()) {
                        case BED_POSE_LOUNGE:
                            indicator_on(k_uptime_get() << 5);
                            break;
                        case BED_POSE_SLEEP:
                            indicator_on(-k_uptime_get() << 5);
                            break;
                        default:
                            __ASSERT(false, "");
                            break;
                    }
                    break;
                case BED_STATE_DONE:
                    indicator_on(INDICATOR_HUE_GREEN);
                    break;
            }
            break;
    }
}

static int setup(void) {
    int err;
    struct wdt_timeout_cfg watchdog_cfg = {
        .window = {
            .min = 0,
            .max = WATCHDOG_TIMEOUT_MS,
        },
        .callback = NULL,
        .flags = WDT_FLAG_RESET_SOC,
    };
    if ((err = wdt_install_timeout(watchdog_dev, &watchdog_cfg))) {
        return err;
    }
    if ((err = wdt_setup(watchdog_dev, WDT_OPT_PAUSE_HALTED_BY_DBG))) {
        return err;
    }
    if ((err = melody_init())) {
        return err;
    }
    if ((err = control_init())) {
        return err;
    }
    if ((err = monitor_init())) {
        return err;
    }
    if ((err = power_init())) {
        return err;
    }
    if ((err = bed_init())) {
        return err;
    }
    return 0;
}

enum command {
    COMMAND_NONE = 0,
    COMMAND_NEXT_MENU = 1,
    COMMAND_NEXT_MENU_MODE = 2,
    COMMAND_MOVE_UP = 3,
    COMMAND_MOVE_DOWN = 4,
    COMMAND_AUTO_MOVE_UP = 5,
    COMMAND_AUTO_MOVE_DOWN = 6,
};

static void loop(void) {
    static int last_error;

    static enum command command_previous;
    static bool command_issued;   // true if the command has been issued, result indicates most recent status
    static int command_result;    // 0 means done (ready to rest), 1 means in progress (issue again), < 0 means error (abort)
    static int64_t command_time;  // time when the command was last issued
    static enum control_action control_action_previous;

    // Determine which command to perform based on control inputs.
    enum control_action control_action_next = control_get_action();
    enum command command_next;
    switch (control_action_next) {
        case CONTROL_ACTION_HOLD_UP:
            command_next = COMMAND_MOVE_UP;
            break;
        case CONTROL_ACTION_HOLD_UP_THEN_PRESS_MODE:
            command_next = COMMAND_AUTO_MOVE_UP;
            break;
        case CONTROL_ACTION_HOLD_DOWN:
            command_next = COMMAND_MOVE_DOWN;
            break;
        case CONTROL_ACTION_HOLD_DOWN_THEN_PRESS_MODE:
            command_next = COMMAND_AUTO_MOVE_DOWN;
            break;
        case CONTROL_ACTION_HOLD_MODE:
            command_next = menu != MENU_MAIN ? COMMAND_NEXT_MENU : COMMAND_NONE;
            break;
        case CONTROL_ACTION_LONG_HOLD_MODE:
            command_next = menu == MENU_MAIN ? COMMAND_NEXT_MENU : COMMAND_NONE;
            break;
        case CONTROL_ACTION_RELEASE:
            switch (control_action_previous) {
                case CONTROL_ACTION_PRESS_MODE:
                    command_next = COMMAND_NEXT_MENU_MODE;
                    break;
                default:
                    if ((command_previous == COMMAND_AUTO_MOVE_UP || command_previous == COMMAND_AUTO_MOVE_DOWN)
                            && command_issued && command_result == 1) {
                        command_next = command_previous;
                    } else {
                        command_next = COMMAND_NONE;
                    }
                    break;
            }
            break;
        default:
            command_next = COMMAND_NONE;
            break;
    }
    control_action_previous = control_action_next;
    command_previous = command_next;
    LOG_DBG("Loop control %d, command %d, menu %d, menu mode %d", control_action_next, command_next, menu, menu_mode);

    // Invoke the command.
    const struct monitor_setting setting = monitor_get_setting();
    bool did_move = false;
    if (command_next == COMMAND_NONE) {
        command_issued = false;
        command_result = 0;
    } else if (!command_issued || command_result == 1) {
        command_issued = true;
        command_time = k_uptime_get();
        command_result = 0;
        switch (command_next) {
            case COMMAND_MOVE_UP:
            case COMMAND_AUTO_MOVE_UP:
                command_result = do_move(/*up*/ true, setting);
                did_move = true;
                break;
            case COMMAND_MOVE_DOWN:
            case COMMAND_AUTO_MOVE_DOWN:
                command_result = do_move(/*up*/ false, setting);
                did_move = true;
                break;
            case COMMAND_NEXT_MENU:
                do_next_menu();
                break;
            case COMMAND_NEXT_MENU_MODE:
                do_next_menu_mode();
                break;
            default:
                break;
        }
    }
    if (!command_issued || command_result <= 0) {
        int err = do_rest();
        if (!command_result) {
            command_result = err;
        }
    }
    static int log_err_command_result;
    static enum command log_err_command_next;
    if (log_err_command_result != command_result || log_err_command_next != command_next) {
        log_err_command_result = command_result;
        log_err_command_next = command_next;
        if (command_result < 0) {
            LOG_ERR("Error %d from command %d", log_err_command_result, log_err_command_next);
        }
    }

    if (command_result < 0) {
        melody_play_error(command_result);
        last_error = command_result;
    } else if (did_move && menu == MENU_MAIN && command_result == 0) {
        melody_play_pose();
    }

    // Update menu.
    if (menu != MENU_MAIN && k_uptime_get() - command_time >= MENU_TIMEOUT_MS) {
        do_goto_menu(MENU_MAIN);
    }
    if (menu != MENU_MAIN) {
        // Enable 5V power so the span hall sensors operate while on the test menu.
        power_5v_request(POWER_DEMAND_TEST);
    } else {
        power_5v_release(POWER_DEMAND_TEST);
    }

    // Update indicators.
    if (command_result < 0) {
        show_error(command_result);
    } else if (k_uptime_get() - command_time < ACTIVITY_TIMEOUT_MS
            || menu != MENU_MAIN) {
        show_status();
    } else {
        indicator_pattern(NULL, 0);
    }

    // Update monitor status.
    struct monitor_status status = {
        .bed_state = bed_get_state(),
        .bed_pose_current = bed_get_current_pose(),
        .bed_pose_target = bed_get_target_pose(),
        .lift_position = lift_get_position(),
        .lift_state = lift_get_state(),
        .span_position = span_get_position(),
        .span_state = span_get_state(),
        .control_inhibited = setting.control_inhibit,
        .control_active = command_issued,
        .control_error = !!command_result,
        .last_error = -last_error,
    };
    monitor_set_status(status);
}

int main(void) {
    int err;
    if ((err = setup())) {
        indicator_on(INDICATOR_HUE_RED);
        return err;
    }

    while (true) {
        if ((err = wdt_feed(watchdog_dev, 0))) {
            return err;
        }
        loop();
        k_msleep(10);
    }
    return 0;
}
```

## src/control.c
```c
#include <errno.h>
#include <zephyr/drivers/gpio.h>
#include <zephyr/kernel.h>
#include <zephyr/sys/atomic.h>

#include "control.h"

#define ZEPHYR_USER_NODE DT_PATH(zephyr_user)
static const struct gpio_dt_spec control_up_gpio = GPIO_DT_SPEC_GET(ZEPHYR_USER_NODE, control_up_gpios);
static const struct gpio_dt_spec control_down_gpio = GPIO_DT_SPEC_GET(ZEPHYR_USER_NODE, control_down_gpios);

#define CONTROL_DEBOUNCE_MS (10)
#define CONTROL_HOLD_MS (500)
#define CONTROL_LONG_HOLD_MS (3000 - CONTROL_HOLD_MS)

static struct gpio_callback control_gpio_callback;

static atomic_t control_action_pending;
static atomic_t control_action_current;

static void control_work_handler(struct k_work* work);
K_WORK_DELAYABLE_DEFINE(control_work, control_work_handler);

static void control_gpio_handler(const struct device *port, struct gpio_callback *cb, gpio_port_pins_t pins) {
    gpio_port_value_t value = 0;
    gpio_port_get(port, &value);
    bool control_up = IS_BIT_SET(value, control_up_gpio.pin);
    bool control_down = IS_BIT_SET(value, control_down_gpio.pin);
    enum control_action action;
    if (control_up && !control_down) {
        action = CONTROL_ACTION_PRESS_UP;
    } else if (control_down && !control_up) {
        action = CONTROL_ACTION_PRESS_DOWN;
    } else if (control_up && control_down) {
        action = CONTROL_ACTION_PRESS_MODE;
    } else {
        action = CONTROL_ACTION_RELEASE;
    }
    atomic_set(&control_action_pending, action);
    k_work_reschedule(&control_work, K_MSEC(CONTROL_DEBOUNCE_MS));
}

static void control_work_handler(struct k_work* work) {
    enum control_action pending = atomic_get(&control_action_pending);
    enum control_action current = atomic_get(&control_action_current);
    bool reschedule_for_hold;
    k_timeout_t hold_time;
    switch (pending) {
        case CONTROL_ACTION_PRESS_UP:
            if (current == CONTROL_ACTION_HOLD_UP_THEN_PRESS_MODE) {
                return; // no change
            }
            reschedule_for_hold = atomic_cas(&control_action_pending, pending, CONTROL_ACTION_HOLD_UP);
            hold_time = K_MSEC(CONTROL_HOLD_MS);
            break;
        case CONTROL_ACTION_PRESS_DOWN:
            if (current == CONTROL_ACTION_HOLD_DOWN_THEN_PRESS_MODE) {
                return; // no change
            }
            reschedule_for_hold = atomic_cas(&control_action_pending, pending, CONTROL_ACTION_HOLD_DOWN);
            hold_time = K_MSEC(CONTROL_HOLD_MS);
            break;
        case CONTROL_ACTION_PRESS_MODE: {
            enum control_action current = atomic_get(&control_action_current);
            switch (current) {
                case CONTROL_ACTION_HOLD_UP:
                    pending = CONTROL_ACTION_HOLD_UP_THEN_PRESS_MODE;
                    reschedule_for_hold = false;
                    break;
                case CONTROL_ACTION_HOLD_DOWN:
                    pending = CONTROL_ACTION_HOLD_DOWN_THEN_PRESS_MODE;
                    reschedule_for_hold = false;
                    break;
                case CONTROL_ACTION_HOLD_UP_THEN_PRESS_MODE:
                case CONTROL_ACTION_HOLD_DOWN_THEN_PRESS_MODE:
                    return; // no change
                default:
                    reschedule_for_hold = atomic_cas(&control_action_pending, pending, CONTROL_ACTION_HOLD_MODE);
                    hold_time = K_MSEC(CONTROL_HOLD_MS);
                    break;
            }
            break;
        }
        case CONTROL_ACTION_HOLD_MODE:
            reschedule_for_hold = atomic_cas(&control_action_pending, pending, CONTROL_ACTION_LONG_HOLD_MODE);
            hold_time = K_MSEC(CONTROL_LONG_HOLD_MS);
            break;
        default:
            reschedule_for_hold = false;
            hold_time = K_MSEC(0);
            break;
    }
    if (reschedule_for_hold) {
        k_work_reschedule(&control_work, hold_time);
    }

    atomic_set(&control_action_current, pending);
}

int control_init(void) {
    int err;
    const struct device *port = control_up_gpio.port;
    if (port != control_down_gpio.port) {
        return -EIO;
    }
    if (!device_is_ready(port)) {
        return -ENODEV;
    }
    gpio_init_callback(&control_gpio_callback, control_gpio_handler,
        BIT(control_up_gpio.pin) | BIT(control_down_gpio.pin));

    if ((err = gpio_pin_configure_dt(&control_up_gpio, GPIO_INPUT)) ||
            (err = gpio_pin_configure_dt(&control_down_gpio, GPIO_INPUT))) {
        return err;
    }
    if ((err = gpio_pin_interrupt_configure_dt(&control_up_gpio, GPIO_INT_EDGE_BOTH)) ||
            (err = gpio_pin_interrupt_configure_dt(&control_down_gpio, GPIO_INT_EDGE_BOTH))) {
        return err;
    }
    if ((err = gpio_add_callback(port, &control_gpio_callback))) {
        return err;
    }
    return 0;
}

enum control_action control_get_action(void) {
    return atomic_get(&control_action_current);
}
```

## src/control.h
```c
/**
 * @file
 * @brief Reads the control button state.
 */

#pragma once

#include <stdint.h>

enum control_action {
    CONTROL_ACTION_RELEASE = 0,
    CONTROL_ACTION_PRESS_UP = 1,
    CONTROL_ACTION_PRESS_DOWN = 2,
    CONTROL_ACTION_PRESS_MODE = 3,
    CONTROL_ACTION_HOLD_UP = 4,
    CONTROL_ACTION_HOLD_DOWN = 5,
    CONTROL_ACTION_HOLD_MODE = 6,
    CONTROL_ACTION_HOLD_UP_THEN_PRESS_MODE = 7,
    CONTROL_ACTION_HOLD_DOWN_THEN_PRESS_MODE = 8,
    CONTROL_ACTION_LONG_HOLD_MODE = 9,
};

/**
 * @brief Get the action determined by the buttons.
 */
enum control_action control_get_action(void);

/**
 * @brief Initialize the control driver.
 */
int control_init(void);
```

## src/errors.h
```c
/**
 * @file
 * @brief Specific error codes that describe the state of the system.
 *
 * These error codes share space with the negative errno set of values and are constrained
 * to fit into 1 byte when reported to external systems so they start at -255 and work
 * their way up.  The color of the blink error is related to the error category and the
 * index determines the number of indicator blinks for that error.
 */

#define ERROR_CATEGORY(err) (-(err) >> 3)
#define ERROR_INDEX(err) ((-(err) & 7) + 1)

// MAGENTA
#define CONTROL_ERROR_FIRST_ (-248)
#define CONTROL_ERROR_INHIBITED (CONTROL_ERROR_FIRST_)  /* Movement of the bed has been remotely inhibited. */

// AMBER
#define BED_ERROR_FIRST_ (-240)
#define BED_ERROR_BAD_STATE (BED_ERROR_FIRST_)  /* The bed components are in an unknown or unexpected state. */

// CYAN
#define LIFT_ERROR_FIRST_ (-232)
#define LIFT_ERROR_FAULT (LIFT_ERROR_FIRST_)       /* Motor driver reported a fault. */
#define LIFT_ERROR_DESYNC (LIFT_ERROR_FIRST_ - 1)  /* The actuators lost synchronization. */
#define LIFT_ERROR_STALL (LIFT_ERROR_FIRST_ - 2)   /* Lift stationary when it should be moving or the hall sensors are not working correctly. */
#define LIFT_ERROR_DRIVER (LIFT_ERROR_FIRST_ - 3)  /* I/O error communicating with the motor driver. */
#define LIFT_ERROR_TIMEOUT (LIFT_ERROR_FIRST_ - 4) /* Operation timed out because poll wasn't called often enough. */

// BLUE
#define SPAN_ERROR_FIRST_ (-224)
#define SPAN_ERROR_FAULT (SPAN_ERROR_FIRST_)          /* Motor driver reported a fault. */
#define SPAN_ERROR_DESYNC (SPAN_ERROR_FIRST_ - 1)     /* The actuators lost synchronization. */
#define SPAN_ERROR_NOT_HOME (SPAN_ERROR_FIRST_ - 2)   /* The actuators did not stall at their home position as expected. */
#define SPAN_ERROR_NOT_TRAVEL (SPAN_ERROR_FIRST_ - 3) /* The actuators traveled further than the expected distance without stalling. */
#define SPAN_ERROR_DRIVER (SPAN_ERROR_FIRST_ - 4)     /* I/O error communicating with the motor driver. */
#define SPAN_ERROR_TIMEOUT (SPAN_ERROR_FIRST_ - 5)    /* Operation timed out because poll wasn't called often enough. */
```

## src/indicator.c
```c
/**
 * @file Component to indicate status with color and flashing patterns.
 */

#include <zephyr/drivers/pwm.h>
#include <zephyr/kernel.h>

#include "indicator.h"

static const struct pwm_dt_spec red_pwm = PWM_DT_SPEC_GET_BY_IDX(DT_NODELABEL(indicator_status), 0);
static const struct pwm_dt_spec green_pwm = PWM_DT_SPEC_GET_BY_IDX(DT_NODELABEL(indicator_status), 1);
static const struct pwm_dt_spec blue_pwm = PWM_DT_SPEC_GET_BY_IDX(DT_NODELABEL(indicator_status), 2);
static const struct pwm_dt_spec power_pwm = PWM_DT_SPEC_GET_BY_IDX(DT_NODELABEL(indicator_power), 0);

K_SEM_DEFINE(indicator_sem, 1, 1);

static const indicator_pattern_t *indicator_pattern_current;
static unsigned indicator_pattern_index;
static unsigned indicator_pattern_cycle;
static unsigned indicator_pattern_param;
static bool indicator_pattern_on;

static void indicator_pattern_handler(struct k_work* work);
K_WORK_DELAYABLE_DEFINE(indicator_pattern_work, indicator_pattern_handler);

// Brightness scale factors: 0 (off), 64 (full bright)
#define INDICATOR_RED_SCALE (20)
#define INDICATOR_GREEN_SCALE (8)
#define INDICATOR_BLUE_SCALE (12)
#define INDICATOR_POWER_SCALE (32)
#define INDICATOR_SCALE_BITS (6)

static void indicator_pwm_set_off_l() {
    pwm_set_pulse_dt(&red_pwm, 0);
    pwm_set_pulse_dt(&green_pwm, 0);
    pwm_set_pulse_dt(&blue_pwm, 0);
    pwm_set_pulse_dt(&power_pwm, 0);
}

static void indicator_pwm_set_on_l(unsigned hue) {
    unsigned r, g, b;
    hue = ((hue & 0xffff) * 1536 + 0x8000) >> 16;
    if (hue < 512) {
        if (hue < 256) {
            g = hue;
            r = 256;
        } else {
            r = 512 - hue;
            g = 256;
        }
        b = 0;
    } else if (hue < 1024) {
        if (hue < 768) {
            b = hue - 512;
            g = 256;
        } else {
            g = 1024 - hue;
            b = 256;
        }
        r = 0;
    } else {
        if (hue < 1280) {
            r = hue - 1024;
            b = 256;
        } else {
            b = 1536 - hue;
            r = 256;
        }
        g = 0;
    }

    pwm_set_pulse_dt(&red_pwm, (((r * red_pwm.period) >> 8) * INDICATOR_RED_SCALE) >> INDICATOR_SCALE_BITS);
    pwm_set_pulse_dt(&green_pwm, (((g * green_pwm.period) >> 8) * INDICATOR_GREEN_SCALE) >> INDICATOR_SCALE_BITS);
    pwm_set_pulse_dt(&blue_pwm, (((b * blue_pwm.period) >> 8) * INDICATOR_BLUE_SCALE) >> INDICATOR_SCALE_BITS);
    pwm_set_pulse_dt(&power_pwm, (power_pwm.period * INDICATOR_POWER_SCALE) >> INDICATOR_SCALE_BITS);
}

static void indicator_pattern_advance_l(void) {
    for (;;) {
        const struct indicator_pattern_entry *entry = &indicator_pattern_current[indicator_pattern_index];
        if (!indicator_pattern_on) {
            if (entry->cycles) {
                indicator_pattern_on = true;
                indicator_pwm_set_on_l(entry->hue);
                k_work_reschedule(&indicator_pattern_work, K_MSEC(entry->on_time * 100));
                break; // wait for next cycle
            }
            if (entry->on_time) {
                break; // end pattern
            }
            indicator_pattern_index = 0; // repeat pattern
            indicator_pattern_cycle = 0;
            if (entry->off_time) {
                k_work_reschedule(&indicator_pattern_work, K_MSEC(entry->off_time * 100));
                break; // wait for delay between repetitions
            }
        } else {
            indicator_pattern_cycle += 1;
            unsigned cycles = (entry->cycles == INDICATOR_PATTERN_PARAM_CYCLES ? indicator_pattern_param : entry->cycles);
            if (indicator_pattern_cycle >= cycles) {
                indicator_pattern_index += 1;
                indicator_pattern_cycle = 0;
            }
            indicator_pattern_on = false;
            if (entry->off_time) {
                indicator_pwm_set_off_l();
                k_work_reschedule(&indicator_pattern_work, K_MSEC(entry->off_time * 100));
                break; // wait for next cycle
            }
        }
    }
}

static void indicator_pattern_handler(struct k_work* work) {
    k_sem_take(&indicator_sem, K_FOREVER);
    if (indicator_pattern_current) {
        indicator_pattern_advance_l();
    } else if (indicator_pattern_on) {
        indicator_pwm_set_off_l();
    }
    k_sem_give(&indicator_sem);
}

void indicator_off(void) {
    k_sem_take(&indicator_sem, K_FOREVER);
    indicator_pattern_current = NULL;
    indicator_pattern_on = false;
    indicator_pwm_set_off_l();
    k_sem_give(&indicator_sem);
}

void indicator_on(unsigned hue) {
    k_sem_take(&indicator_sem, K_FOREVER);
    indicator_pattern_current = NULL;
    indicator_pattern_on = false;
    indicator_pwm_set_on_l(hue);
    k_sem_give(&indicator_sem);
}

void indicator_pattern(const indicator_pattern_t *pattern, unsigned param) {
    k_sem_take(&indicator_sem, K_FOREVER);
    if (indicator_pattern_current != pattern || indicator_pattern_param != param) {
        indicator_pattern_current = pattern;
        indicator_pattern_param = param;
        if (pattern) {
            indicator_pattern_index = 0;
            indicator_pattern_cycle = 0;
            indicator_pattern_on = false;
            indicator_pattern_advance_l();
        }
    } else if (!indicator_pattern_on) {
        indicator_pwm_set_off_l();
    }
    k_sem_give(&indicator_sem);
}
```

## src/indicator.h
```c
/**
 * @file
 * @brief Sets the status indicator color.
 */

#pragma once

#include <stdint.h>

#define INDICATOR_HUE_RED (0)
#define INDICATOR_HUE_AMBER (5462)
#define INDICATOR_HUE_YELLOW (10923)
#define INDICATOR_HUE_GREEN (21845)
#define INDICATOR_HUE_CYAN (32768)
#define INDICATOR_HUE_BLUE (43691)
#define INDICATOR_HUE_MAGENTA (54613)

/**
 * @brief Turn the indicator off.
 */
void indicator_off(void);

/**
 * @brief Turn the indicator on.
 *
 * @param hue Color hue in a range from 0 to 65536, cycles every 65536.
 */
void indicator_on(unsigned hue);

/**
 * @brief Defines a pattern of colors for an indicator.
 *
 * The indicator turns on with the given hue for on_time then off for off_time blinking up to cycle times.
 * The time intervals are specified in 0.1 second increments.
 * Terminate an array of pattern entries with an entry with cycles = 0.
 * If the last entry has zero on_time then the pattern repeats after off_time interval, otherwise it stops.
 * If the value of cycles is INDICATOR_PATTERN_PARAM_CYCLES then the pattern parameter determines the count.
 */
struct indicator_pattern_entry {
    unsigned hue : 16;
    unsigned on_time : 5;
    unsigned off_time : 5;
    unsigned cycles : 6;
};
_Static_assert(sizeof(struct indicator_pattern_entry) == 4, "");
typedef struct indicator_pattern_entry indicator_pattern_t;

#define INDICATOR_PATTERN_PARAM_CYCLES (0x3f)
#define INDICATOR_PATTERN_ENTRY(hue_, on_time_, off_time_, cycles_) { .hue = hue_, .on_time = on_time_, .off_time = off_time_, .cycles = cycles_ }
#define INDICATOR_PATTERN_ENTRY_REPEAT(delay_) INDICATOR_PATTERN_ENTRY(0, 0, delay_, 0)
#define INDICATOR_PATTERN_ENTRY_END INDICATOR_PATTERN_ENTRY(0, 1, 0, 0)
#define INDICATOR_PATTERN_ONCE(name, ...) static const indicator_pattern_t name[] = { __VA_ARGS__, INDICATOR_PATTERN_ENTRY_END }
#define INDICATOR_PATTERN_LOOP(name, delay_, ...) static const indicator_pattern_t name[] = { __VA_ARGS__, INDICATOR_PATTERN_ENTRY_REPEAT(delay_) }

/**
 * @brief Perform an indicator pattern.
 *
 * The pattern remains active until indicator_on or indicator_off are called.
 * Calling this function repeatedly with the same pattern does not restart it.
 *
 * @param pattern Pattern to perform, or NULL to stop the pattern at the end
 * its current on-time cycle or turn the indicator off immediately if no pattern
 * is running.
 * @param param Parameter value for INDICATOR_PATTERN_PARAM_CYCLES, 0 if unused.
 */
void indicator_pattern(const indicator_pattern_t *pattern, unsigned cycles);
```

## src/melody.c
```c
#include <zephyr/drivers/pwm.h>
#include <zephyr/kernel.h>

#include "melody.h"

static const struct pwm_dt_spec sound_pwm = PWM_DT_SPEC_GET_BY_IDX(DT_NODELABEL(sound), 0);

K_SEM_DEFINE(melody_sem, 1, 1);

static const melody_t *melody_current;
static unsigned melody_index;
static uint64_t melody_cycles_per_second;

static void melody_handler(struct k_work* work);
K_WORK_DELAYABLE_DEFINE(melody_work, melody_handler);

static void melody_set_sound_l(unsigned freq) {
    if (freq) {
        unsigned period = melody_cycles_per_second / freq;
        pwm_set_cycles(sound_pwm.dev, sound_pwm.channel, period, period / 2, sound_pwm.flags);
    } else {
        pwm_set_cycles(sound_pwm.dev, sound_pwm.channel, 65535, 0, sound_pwm.flags);
    }
}

static void melody_advance_l(void) {
    const struct melody_tone *tone = &melody_current[melody_index];
    if (tone->duration) {
        melody_set_sound_l(tone->freq);
        k_work_reschedule(&melody_work, K_MSEC(tone->duration));
        melody_index += 1;
    } else {
        melody_set_sound_l(0);
        melody_current = NULL;
    }
}

static void melody_handler(struct k_work* work) {
    k_sem_take(&melody_sem, K_FOREVER);
    if (melody_current) {
        melody_advance_l();
    }
    k_sem_give(&melody_sem);
}

int melody_init(void) {
    return pwm_get_cycles_per_sec(sound_pwm.dev, sound_pwm.channel, &melody_cycles_per_second);
}

void melody_stop(void) {
    k_sem_take(&melody_sem, K_FOREVER);
    melody_current = NULL;
    melody_set_sound_l(0);
    k_sem_give(&melody_sem);
}

void melody_play(const melody_t *melody) {
    k_sem_take(&melody_sem, K_FOREVER);
    if (melody_current != melody) {
        melody_current = melody;
        melody_index = 0;
        melody_advance_l();
    }
    k_sem_give(&melody_sem);
}
```

## src/melody.h
```c
/**
 * @file
 * @brief Plays melodies through a piezo buzzer.
 */

#pragma once

#include <stdint.h>

/**
 * @brief A musical tone in a melody.
 * 
 * The tone's frequency is specified in Hz.  If it is zero, no tone is played (performs a rest).
 * The tone's duration is specified in ms.  If it is zero, the melody ends.
 */
struct melody_tone {
    uint16_t freq;
    uint16_t duration;
};
_Static_assert(sizeof(struct melody_tone) == 4, "");
typedef struct melody_tone melody_t;

#define MELODY_NOTE_C6 (1047)
#define MELODY_NOTE_D6 (1175)
#define MELODY_NOTE_E6 (1319)
#define MELODY_NOTE_E6 (1319)
#define MELODY_NOTE_F6 (1397)
#define MELODY_NOTE_G6 (1568)

#define MELODY_TONE(freq_, duration_) { .freq = (freq_), .duration = (duration_) }
#define MELODY_NOTE(name_, duration_) MELODY_TONE(_CONCAT(MELODY_NOTE_, name_), (duration_))
#define MELODY_REST(duration_) { .freq = 0, .duration = (duration_) }
#define MELODY_END { .freq = 0, .duration = 0 }
#define MELODY(name, ...) static const melody_t name[] = { __VA_ARGS__, MELODY_END }

int melody_init(void);

/**
 * @brief Stops the melody.
 */
void melody_stop(void);

/**
 * @brief Plays a melody.
 *
 * Calling this function repeatedly with the same melody does not restart it.
 *
 * @param melody Melody to perform, or NULL to stop the current melody
 */
void melody_play(const melody_t *melody);
```

## src/monitor.c
```c
/**
 * @file Component to implement external monitoring of the bed lift as an I2C target.
 *
 * PROTOCOL:
 * 
 *   I2C target address: 16 (arbitrarily chosen)
 *   Write 8 bit register number to target then read or write 32 bit little-endian encoded register value.
 *
 * REGISTER 0x00: STATUS (read-only)
 *
 *   Bit  0 -  1: Current bed state, @see enum bed_state
 *   Bit  2 -  3: Current bed pose, @see enum bed_pose
 *   Bit  4 -  5: Target bed pose, @see enum bed_pose
 *   Bit  8 - 10: Current lift position, @see enum lift_position
 *   Bit 11 - 13: Current lift state, @see enum lift_state
 *   Bit 14 - 15: Current span position, @see enum span_position
 *   Bit 16 - 17: Current span state, @see enum span_state
 *   Bit      21: Control inhibited; set to 1 when the control panel is inhibited from performing actions
 *   Bit      22: Control active; set to 1 when the control panel is performing an action
 *   Bit      23: Control error; set to 1 when the control panel's action has encountered an error
 *   Bit 24 - 31: Last reported control error (positive value)
 *
 * REGISTER 0x01: CONTROL (read-write)
 *
 *   Bit       0: Control inhibit; set to 1 to inhibit the control panel from performing actions
 *
 * REGISTER 0x02: LIFT DEBUG (read-only)
 *
 * REGISTER 0x03: SPAN DEBUG (read-only)
 *
 * REGISTER 0x04: SPAN TEST (read-write)
 */

#include <errno.h>
#include <zephyr/drivers/i2c.h>
#include <zephyr/kernel.h>
#include <zephyr/sys/atomic.h>

#include "monitor.h"

/*
 * Registers.
 */

enum monitor_register {
	MONITOR_REGISTER_STATUS = 0,
	MONITOR_REGISTER_SETTING = 1,
	MONITOR_REGISTER_LIFT_DEBUG = 2,
	MONITOR_REGISTER_SPAN_DEBUG = 3,
	MONITOR_REGISTER_SPAN_TEST = 4,
};

static atomic_t monitor_registers[5];

static inline bool monitor_register_is_valid(uint8_t reg) {
	return reg >= 0 && reg < ARRAY_SIZE(monitor_registers);
}

static inline bool monitor_register_is_externally_writable(uint8_t reg) {
	return reg == MONITOR_REGISTER_SETTING || reg == MONITOR_REGISTER_SPAN_TEST;
}

static inline void monitor_register_write(uint8_t reg, uint32_t value) {
	atomic_set(&monitor_registers[reg], value);
}

static inline uint32_t monitor_register_read(uint8_t reg) {
	return atomic_get(&monitor_registers[reg]);
}

/*
 * I2C target.
 */

static const struct device *monitor_i2c_bus = DEVICE_DT_GET(DT_NODELABEL(i2c1));

#define MONITOR_I2C_TARGET_ADDRESS (16)

enum monitor_i2c_state {
	MONITOR_I2C_IDLE = 0,
	MONITOR_I2C_WRITE_REGISTER = 1,
	MONITOR_I2C_READ_OR_WRITE_VALUE = 2,
	MONITOR_I2C_WRITE_VALUE = 3,
	MONITOR_I2C_READ_VALUE = 4,
	MONITOR_I2C_READ_FINISHED = 5,
	MONITOR_I2C_ERROR = 6,
};

struct monitor_i2c_data {
	enum monitor_i2c_state state : 8;
	uint8_t reg;
	uint8_t remaining;
	uint32_t value;
};
static struct monitor_i2c_data monitor_i2c_data;

static int monitor_i2c_target_write_requested_handler(struct i2c_target_config *config) {
	monitor_i2c_data.state = MONITOR_I2C_WRITE_REGISTER;
	return 0;
}

static int monitor_i2c_target_write_received_handler(struct i2c_target_config *config, uint8_t val) {
	switch (monitor_i2c_data.state) {
		case MONITOR_I2C_WRITE_REGISTER:
			if (monitor_register_is_valid(val)) {
				monitor_i2c_data.reg = val;
				monitor_i2c_data.state = MONITOR_I2C_READ_OR_WRITE_VALUE;
				return 0;
			}
			monitor_i2c_data.state = MONITOR_I2C_ERROR;
			return -1;
		case MONITOR_I2C_READ_OR_WRITE_VALUE:
			monitor_i2c_data.state = MONITOR_I2C_WRITE_VALUE;
			monitor_i2c_data.value = 0;
			monitor_i2c_data.remaining = sizeof(uint32_t);
			__fallthrough;
		case MONITOR_I2C_WRITE_VALUE:
			monitor_i2c_data.value >>= 8;
			monitor_i2c_data.value |= val << 24;
			if (--monitor_i2c_data.remaining) {
				return 0;
			}
			if (monitor_register_is_externally_writable(monitor_i2c_data.reg)) {
				monitor_register_write(monitor_i2c_data.reg, monitor_i2c_data.value);
			}
			monitor_i2c_data.state = MONITOR_I2C_IDLE;
			return -1;
		default:
			monitor_i2c_data.state = MONITOR_I2C_ERROR;
			return -1;
	}
}

static int monitor_i2c_target_read_requested_or_processed_handler(struct i2c_target_config *config, uint8_t *val) {
	switch (monitor_i2c_data.state) {
		case MONITOR_I2C_READ_OR_WRITE_VALUE:
			monitor_i2c_data.state = MONITOR_I2C_READ_VALUE;
			monitor_i2c_data.value = monitor_register_read(monitor_i2c_data.reg);
			monitor_i2c_data.remaining = sizeof(uint32_t);
			__fallthrough;
		case MONITOR_I2C_READ_VALUE:
			*val = monitor_i2c_data.value & 0xff;
			monitor_i2c_data.value >>= 8;
			if (--monitor_i2c_data.remaining == 0) {
				monitor_i2c_data.state = MONITOR_I2C_READ_FINISHED;
			}
			return 0;
		case MONITOR_I2C_READ_FINISHED:
			// FIXME: We receive one additional call to read after the last byte has been transmitted.
			// It's unclear whether it is originating from the client (esphome with ESP-IDF) or is simply
			// an artifact of the I2C driver handling the TXIS interrupt condition.  Tolerate the overread
			// instead of reporting an error (which produces logspam).
			*val = 0;
			monitor_i2c_data.state = MONITOR_I2C_IDLE;
			return 0;
		default:
			monitor_i2c_data.state = MONITOR_I2C_ERROR;
			return -1;
	}
}

static int monitor_i2c_target_stop_handler(struct i2c_target_config *config) {
	return 0;
}

static struct i2c_target_callbacks monitor_i2c_target_callbacks = {
	.write_requested = monitor_i2c_target_write_requested_handler,
	.write_received = monitor_i2c_target_write_received_handler,
	.read_requested = monitor_i2c_target_read_requested_or_processed_handler,
	.read_processed = monitor_i2c_target_read_requested_or_processed_handler,
	.stop = monitor_i2c_target_stop_handler,
};

static struct i2c_target_config monitor_i2c_target_config = {
    .address = MONITOR_I2C_TARGET_ADDRESS,
    .callbacks = &monitor_i2c_target_callbacks,
};

int monitor_init(void) {
    return i2c_target_register(monitor_i2c_bus, &monitor_i2c_target_config);
}

void monitor_set_status(struct monitor_status value) {
	monitor_register_write(MONITOR_REGISTER_STATUS, *(uint32_t *)&value);
}

void monitor_set_lift_debug(struct monitor_lift_debug value) {
	monitor_register_write(MONITOR_REGISTER_LIFT_DEBUG, *(uint32_t *)&value);
}

void monitor_set_span_debug(struct monitor_span_debug value) {
	monitor_register_write(MONITOR_REGISTER_SPAN_DEBUG, *(uint32_t *)&value);
}

struct monitor_setting monitor_get_setting(void) {
	uint32_t value = monitor_register_read(MONITOR_REGISTER_SETTING);
	return *(struct monitor_setting *)&value;
}

struct monitor_span_test monitor_get_span_test(void) {
	uint32_t value = monitor_register_read(MONITOR_REGISTER_SPAN_TEST);
	return *(struct monitor_span_test *)&value;
}
```

## src/monitor.h
```c
/**
 * @file
 * @brief Implements the external monitoring interface.
 */

#pragma once

#include <stdint.h>

/**
 * @brief Initialize monitoring.
 */
int monitor_init(void);

struct __packed monitor_status {
    unsigned bed_state : 2;
    unsigned bed_pose_current : 2;
    unsigned bed_pose_target : 2;
    unsigned lift_position : 3;
    unsigned lift_state : 3;
    unsigned span_position : 2;
    unsigned span_state : 3;
    unsigned : 4;
    bool control_inhibited : 1;
    bool control_active : 1;
    bool control_error : 1;
    unsigned last_error : 8;
};
_Static_assert(sizeof(struct monitor_status) == 4, "");

struct __packed monitor_setting {
    bool control_inhibit : 1;
    unsigned : 31;
};
_Static_assert(sizeof(struct monitor_setting) == 4, "");

struct __packed monitor_lift_debug {
    int lift1_duty : 12; // q11 fraction
    int lift2_duty : 12; // q11 fraction
    unsigned limit_state : 2;
    unsigned : 6;
};
_Static_assert(sizeof(struct monitor_lift_debug) == 4, "");

struct __packed monitor_span_debug {
    unsigned speed : 23; // microsteps per second
    bool extend : 1;
    unsigned limit_state : 4;
    unsigned limit_seen : 4;
};
_Static_assert(sizeof(struct monitor_span_debug) == 4, "");

struct __packed monitor_span_test {
    unsigned speed_mm_s : 8;
    unsigned accel_mm_s2 : 8;
    unsigned stall_threshold : 12; // if non-zero, override the default
    bool test : 1; // if true, enable test mode
    unsigned : 3;
};
_Static_assert(sizeof(struct monitor_span_test) == 4, "");

void monitor_set_status(struct monitor_status value);
void monitor_set_lift_debug(struct monitor_lift_debug value);
void monitor_set_span_debug(struct monitor_span_debug value);

struct monitor_setting monitor_get_setting(void);
struct monitor_span_test monitor_get_span_test(void);
```

## src/power.c
```c
#include <errno.h>
#include <stdint.h>
#include <stdlib.h>
#include <zephyr/drivers/gpio.h>
#include <zephyr/kernel.h>
#include <zephyr/spinlock.h>

#include "power.h"

#define ZEPHYR_USER_NODE DT_PATH(zephyr_user)

static const struct gpio_dt_spec power_5v_en_gpio = GPIO_DT_SPEC_GET(ZEPHYR_USER_NODE, power_5v_en_gpios);

static struct k_spinlock power_lock;
static unsigned power_demands; // guarded by power_lock

int power_init(void) {
    int err;
    if (!device_is_ready(power_5v_en_gpio.port)) {
        return -ENODEV;
    }
    if ((err = gpio_pin_configure_dt(&power_5v_en_gpio, GPIO_OUTPUT_INACTIVE))) {
        return err;
    }
    return 0;
}

void power_5v_request(unsigned demand) {
    K_SPINLOCK(&power_lock) {
        unsigned old = power_demands;
        power_demands |= demand;
        if (!old && power_demands) {
            gpio_pin_set_dt(&power_5v_en_gpio, true);
        }
    }
}

void power_5v_release(unsigned demand) {
    K_SPINLOCK(&power_lock) {
        unsigned old = power_demands;
        power_demands &= ~demand;
        if (old && !power_demands) {
            gpio_pin_set_dt(&power_5v_en_gpio, false);
        }
    }
}
```

## src/power.h
```c
/**
 * @file
 * @brief Controls the 5V regulator that powers the hall sensors and the expansion port.
 */

#pragma once

#include <stdint.h>

#include "errors.h"

int power_init(void);

#define POWER_DEMAND_LIFT (1u << 0)
#define POWER_DEMAND_SPAN (1u << 1)
#define POWER_DEMAND_TEST (1u << 2)

/**
 * @brief Requests that 5V be provided on behalf of the specified consumer.
 */
void power_5v_request(unsigned demand);

/**
 * @brief Releases the request for power on behalf of the specified consumer.
 */
void power_5v_release(unsigned demand);
```
